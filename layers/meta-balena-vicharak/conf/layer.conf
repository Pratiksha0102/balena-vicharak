## layers/meta-balena-vicharak/conf/layer.conf
```bitbake
BBPATH .= ":${LAYERDIR}"

BBFILES += "${LAYERDIR}/recipes-*/*/*.bb \
            ${LAYERDIR}/recipes-*/*/*.bbappend"

BBFILE_COLLECTIONS += "balena-vicharak"
BBFILE_PATTERN_balena-vicharak := "^${LAYERDIR}/"
BBFILE_PRIORITY_balena-vicharak = "1337"

LAYERSERIES_COMPAT_balena-vicharak = "dunfell"

# override what the BSP defines in the machine conf because we use the Radxa CM3 on a RPi Compute Module 4 IO Board
KERNEL_DEVICETREE_radxa-cm3-io-rk3566 = "rockchip/rk3566-radxa-cm3-rpi-cm4-io.dtb"
UBOOT_MACHINE_radxa-cm3-io-rk3566 = "radxa-cm3-rpi-cm4-io-rk3566_defconfig"
KERNEL_DEVICETREE_rk3588-axon = "rockchip/rk3588-axon-linux.dtb"
UBOOT_MACHINE_rk3588-axon = "rk3588_defconfig"
```
